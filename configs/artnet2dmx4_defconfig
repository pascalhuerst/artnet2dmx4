## configs/artnet2dmx4_defconfig
```kconfig
BR2_arm=y
BR2_cortex_a8=y
BR2_CCACHE=y
BR2_OPTIMIZE_3=y
BR2_TOOLCHAIN_BUILDROOT_GLIBC=y
BR2_KERNEL_HEADERS_VERSION=y
BR2_DEFAULT_KERNEL_VERSION="4.0"
BR2_PACKAGE_HOST_LINUX_HEADERS_CUSTOM_4_0=y
BR2_BINUTILS_VERSION_2_27_X=y
BR2_EXTRA_GCC_CONFIG_OPTIONS="--with-fpu=vfpv3 --with-float=hard"
BR2_TOOLCHAIN_BUILDROOT_CXX=y
BR2_PACKAGE_HOST_GDB=y
BR2_ROOTFS_MERGED_USR=y
BR2_TARGET_GENERIC_HOSTNAME="Artnet2Dmx4"
BR2_TARGET_GENERIC_ISSUE="Welcome to Artnet2Dmx4 linux"
BR2_GENERATE_LOCALE="en_US"
BR2_ROOTFS_OVERLAY="artnet2dmx4/fs-overlay"
BR2_LINUX_KERNEL=y
BR2_LINUX_KERNEL_USE_CUSTOM_CONFIG=y
BR2_LINUX_KERNEL_CUSTOM_CONFIG_FILE="artnet2dmx4/linuxconfig"
BR2_LINUX_KERNEL_UIMAGE=y
BR2_LINUX_KERNEL_UIMAGE_LOADADDR="0x80008000"
BR2_LINUX_KERNEL_DTS_SUPPORT=y
BR2_LINUX_KERNEL_USE_CUSTOM_DTS=y
BR2_LINUX_KERNEL_CUSTOM_DTS_PATH="artnet2dmx4/am335x-boneblack.dts"
BR2_LINUX_KERNEL_INSTALL_TARGET=y
BR2_PACKAGE_BUSYBOX_SHOW_OTHERS=y
BR2_PACKAGE_BUSYBOX_SELINUX=y
BR2_PACKAGE_BZIP2=y
BR2_PACKAGE_BINUTILS=y
BR2_PACKAGE_BINUTILS_TARGET=y
BR2_PACKAGE_CIFS_UTILS=y
BR2_PACKAGE_E2FSPROGS=y
BR2_PACKAGE_LINUX_FIRMWARE=y
BR2_PACKAGE_LINUX_FIRMWARE_RALINK_RT61=y
BR2_PACKAGE_LINUX_FIRMWARE_RALINK_RT73=y
BR2_PACKAGE_LINUX_FIRMWARE_RALINK_RT2XX=y
BR2_PACKAGE_LINUX_FIRMWARE_RTL_81XX=y
BR2_PACKAGE_LINUX_FIRMWARE_RTL_87XX=y
BR2_PACKAGE_I2C_TOOLS=y
BR2_PACKAGE_OLA=y
BR2_PACKAGE_OLA_WEB=y
BR2_PACKAGE_OLA_SLP=y
BR2_PACKAGE_OLA_EXAMPLES=y
BR2_PACKAGE_OLA_PLUGIN_E131=y
BR2_PACKAGE_OLA_PLUGIN_ARTNET=y
BR2_PACKAGE_OLA_PLUGIN_OPENDMX=y
BR2_PACKAGE_OLA_PLUGIN_DUMMY=y
BR2_PACKAGE_OLA_PLUGIN_ESPNET=y
BR2_PACKAGE_OLA_PLUGIN_KINET=y
BR2_PACKAGE_OLA_PLUGIN_MILINT=y
BR2_PACKAGE_OLA_PLUGIN_OSC=y
BR2_PACKAGE_OLA_PLUGIN_PATHPORT=y
BR2_PACKAGE_OLA_PLUGIN_SANDNET=y
BR2_PACKAGE_OLA_PLUGIN_SHOWNET=y
BR2_PACKAGE_OLA_PLUGIN_STAGEPROFI=y
BR2_PACKAGE_OLA_PLUGIN_USBPRO=y
BR2_PACKAGE_GNUTLS=y
BR2_PACKAGE_SQLITE=y
BR2_PACKAGE_LIBXML2=y
BR2_PACKAGE_MOSQUITTO=y
BR2_PACKAGE_LIBGLIB2=y
BR2_PACKAGE_IW=y
BR2_PACKAGE_OPENSSH=y
BR2_PACKAGE_KMOD=y
BR2_PACKAGE_UTIL_LINUX_BINARIES=y
BR2_PACKAGE_UTIL_LINUX_FSCK=y
BR2_PACKAGE_UTIL_LINUX_LOGIN_UTILS=y
BR2_PACKAGE_UTIL_LINUX_MOUNT=y
BR2_PACKAGE_UTIL_LINUX_NOLOGIN=y
BR2_TARGET_ROOTFS_TAR_GZIP=y
BR2_TARGET_UBOOT=y
BR2_TARGET_UBOOT_BOARDNAME="am335x_evm"
BR2_TARGET_UBOOT_FORMAT_IMG=y
BR2_TARGET_UBOOT_SPL=y
BR2_TARGET_UBOOT_SPL_NAME="MLO"
BR2_PACKAGE_HOST_DTC=y
BR2_PACKAGE_HOST_UTIL_LINUX=y
```
